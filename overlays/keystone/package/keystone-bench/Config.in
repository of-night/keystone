## overlays/keystone/package/keystone-bench/Config.in
```kconfig
config BR2_PACKAGE_KEYSTONE_BENCH
        bool "Keystone bench"
        depends on BR2_PACKAGE_HOST_KEYSTONE_SDK
        depends on BR2_PACKAGE_KEYSTONE_RUNTIME
        help
          Bench applications for Keystone, showing a variety
          of functionalities and features
```

## overlays/keystone/package/keystone-demo/Config.in
```kconfig
config BR2_PACKAGE_KEYSTONE_DEMO
        bool "Keystone demo"
        depends on BR2_PACKAGE_HOST_KEYSTONE_SDK
        depends on BR2_PACKAGE_KEYSTONE_RUNTIME
        help
          Example applications for Keystone, showing a variety
          of functionalities and features
```

## overlays/keystone/package/keystone-ipfs/Config.in
```kconfig
config BR2_PACKAGE_KEYSTONE_IPFS
        bool "Keystone ipfs"
        help
          InterPlanetary File System is a protocol and network 
          designed to create a content-addressable, 
          peer-to-peer method of storing and sharing
           hypermedia in a distributed file system.
```
